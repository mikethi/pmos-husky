## u-boot-google-husky/husky_defconfig
```kconfig
# U-Boot defconfig for Google Pixel 8 Pro (husky) -- Tensor G3 (Zuma) SoC
# Drop this file into configs/ inside a U-Boot source tree, then run:
#   make ARCH=arm64 CROSS_COMPILE=aarch64-linux-gnu- husky_defconfig
#   make ARCH=arm64 CROSS_COMPILE=aarch64-linux-gnu- all

CONFIG_ARM=y
CONFIG_ARM64=y
CONFIG_IDENT_STRING=" google-husky"

# DRAM: bank 0 at 0x80000000 (8 GB), bank 1 at 0x880000000 (confirmed in bl31)
CONFIG_NR_DRAM_BANKS=2
CONFIG_SYS_SDRAM_BASE=0x80000000

# U-Boot load address (avoids secure DRAM carve-out below 0x92800000)
CONFIG_SYS_TEXT_BASE=0x80200000
CONFIG_SYS_LOAD_ADDR=0x80080000

# Console: Exynos UART at 0x10870000 (earlycon=exynos4210,0x10870000)
CONFIG_DEBUG_UART=y
CONFIG_DEBUG_UART_BASE=0x10870000
CONFIG_DEBUG_UART_CLOCK=26000000
CONFIG_BAUDRATE=115200

# Boot flow
CONFIG_BOOTDELAY=2
CONFIG_USE_BOOTCOMMAND=y
CONFIG_BOOTCOMMAND="abootimg addr 0x80080000; bootm 0x80080000"

# Android boot image support (husky ships vendor_boot v4)
CONFIG_ANDROID_BOOT_IMAGE=y
CONFIG_CMD_ABOOTIMG=y
CONFIG_ANDROID_BOOTLOADER=y

# Device tree
CONFIG_OF_LIBFDT=y
CONFIG_CMD_FDT=y
CONFIG_CMD_BOOTI=y

# Storage: UFS at 0x13200000
CONFIG_MMC=y
CONFIG_DM_MMC=y

# Fastboot (USB VID=0x18D1 PID=0x4EE7)
CONFIG_USB_GADGET=y
CONFIG_USB_GADGET_DOWNLOAD=y
CONFIG_FASTBOOT=y
CONFIG_FASTBOOT_USB_DEV=0
CONFIG_USB_FASTBOOT_BUF_ADDR=0x82000000
CONFIG_USB_FASTBOOT_BUF_SIZE=0x40000000
```
